## CMakeLists.txt
```
cmake_minimum_required(VERSION 3.20.0)
find_package(Zephyr REQUIRED HINTS $ENV{ZEPHYR_BASE})
project(juxta_ble_observer_min LANGUAGES C)

# Add the main source file
target_sources(app PRIVATE src/main.c) 
```

## Kconfig
```
# Copyright (c) 2024 NeurotechHub
# SPDX-License-Identifier: Apache-2.0

menu "Zephyr"
source "Kconfig.zephyr"
endmenu

# Source library configurations
rsource "../../lib/juxta_vitals_nrf52/Kconfig" 
```

## prj.conf
```kconfig
# Minimal BLE Observer Sample Configuration for Juxta5-4_nRF52840
CONFIG_BT=y
CONFIG_BT_OBSERVER=y
CONFIG_BT_PERIPHERAL=n
CONFIG_BT_DEVICE_NAME="JUXTA-OBSERVER"
CONFIG_BT_DEVICE_NAME_DYNAMIC=n
CONFIG_BT_MAX_CONN=0

# Vitals library for battery and temperature monitoring
CONFIG_JUXTA_VITALS_NRF52=y

# ADC driver (required by vitals library)
CONFIG_ADC=y
CONFIG_ADC_NRFX_SAADC=y

# Sensor driver (required by vitals library)
CONFIG_SENSOR=y

# SPI driver (required by vitals library)
CONFIG_SPI=y

# Counter/RTC driver (required by vitals library) - DISABLED due to BLE conflict
# CONFIG_COUNTER=y
# CONFIG_NRFX_RTC0=y

# Logging
CONFIG_LOG=y
CONFIG_LOG_DEFAULT_LEVEL=2
CONFIG_CONSOLE=y
CONFIG_USE_SEGGER_RTT=y
CONFIG_RTT_CONSOLE=y
CONFIG_LOG_BACKEND_RTT=y
CONFIG_SEGGER_RTT_BUFFER_SIZE_UP=4096
CONFIG_SEGGER_RTT_BUFFER_SIZE_DOWN=16

# Memory settings
CONFIG_SYSTEM_WORKQUEUE_STACK_SIZE=2048
CONFIG_MAIN_STACK_SIZE=2048
CONFIG_ISR_STACK_SIZE=2048

# Stack protection
CONFIG_HW_STACK_PROTECTION=y
CONFIG_THREAD_STACK_INFO=y 
```

## src/main.c
```c
#include <zephyr/kernel.h>
#include <zephyr/bluetooth/bluetooth.h>
#include <zephyr/bluetooth/hci.h>
#include <zephyr/sys/printk.h>

static void device_found(const bt_addr_le_t *addr, int8_t rssi, uint8_t type, struct net_buf_simple *ad)
{
    char addr_str[BT_ADDR_LE_STR_LEN];
    bt_addr_le_to_str(addr, addr_str, sizeof(addr_str));
    printk("Device found: %s (RSSI %d), type %u, AD data len %u\n", addr_str, rssi, type, ad->len);
}

void main(void)
{
    int err;
    struct bt_le_scan_param scan_param = {
        .type = BT_LE_SCAN_TYPE_PASSIVE,
        .options = BT_LE_SCAN_OPT_FILTER_DUPLICATE,
        .interval = BT_GAP_SCAN_FAST_INTERVAL,
        .window = BT_GAP_SCAN_FAST_WINDOW,
    };

    printk("Starting Minimal Observer Scan Test (Back to Original)\n");

    err = bt_enable(NULL);
    if (err)
    {
        printk("Bluetooth init failed (err %d)\n", err);
        return;
    }

    err = bt_le_scan_start(&scan_param, device_found);
    if (err)
    {
        printk("Start scanning failed (err %d)\n", err);
        return;
    }

    printk("Started scanning...\n");
    while (1)
    {
        k_sleep(K_SECONDS(10));
    }
}
```
