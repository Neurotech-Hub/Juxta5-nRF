## applications/juxta-ble/child_image/boards/Juxta5-6_nRF52840_defconfig
```kconfig
# Minimal board configuration for MCUboot child image
# Override the main board defconfig to disable unnecessary peripherals

# Hardware Protection (keep from main board)
CONFIG_ARM_MPU=y
CONFIG_HW_STACK_PROTECTION=y

# Essential Hardware Peripherals for MCUboot only
CONFIG_GPIO=y
CONFIG_GPIO_NRFX=y

# DISABLE all peripherals not needed by bootloader
CONFIG_ADC=n
CONFIG_ADC_NRFX_SAADC=n
CONFIG_SPI=n
CONFIG_SPI_NRFX=n
CONFIG_SENSOR=n
CONFIG_I2C=n

# Hardware Limitations (keep from main board)
CONFIG_UART_NRFX=n
CONFIG_UART_CONSOLE=n

# Default Console (RTT) - disable for minimal bootloader
CONFIG_USE_SEGGER_RTT=n
CONFIG_RTT_CONSOLE=n
CONFIG_CONSOLE=n
```

## boards/NeurotechHub/Juxta5-1_ADC/Juxta5-1_ADC_defconfig
```kconfig
# Enable MPU and stack protection
CONFIG_ARM_MPU=y
CONFIG_HW_STACK_PROTECTION=y

# Enable GPIO
CONFIG_GPIO=y

# Enable SPI
CONFIG_SPI=y
CONFIG_SPI_NRFX=y

# Enable ADC
CONFIG_ADC=y
CONFIG_ADC_NRFX_SAADC=y

# Enable RTC
CONFIG_RTC=y
CONFIG_COUNTER=y

# Enable FRAM support
# EEPROM drivers not needed - using custom FRAM library
CONFIG_EEPROM=n
CONFIG_EEPROM_AT25=n
```

## boards/NeurotechHub/Juxta5-1_AXY/Juxta5-1_AXY_defconfig
```kconfig
CONFIG_ARM_MPU=y
CONFIG_HW_STACK_PROTECTION=y

# Enable GPIO
CONFIG_GPIO=y

# Enable SPI
CONFIG_SPI=y
CONFIG_SPI_NRFX=y

# Enable Sensor support for accelerometer
CONFIG_SENSOR=y

# Enable FRAM support
CONFIG_EEPROM=y
CONFIG_EEPROM_AT2X_EMUL=y

# Enable interrupts and GPIO callbacks
CONFIG_GPIO_INT_DEBOUNCE=y
```

## lib/Kconfig
```kconfig
# Libraries Configuration
#
# Copyright (c) 2024 NeurotechHub
# SPDX-License-Identifier: Apache-2.0

menu "JUXTA Libraries"

source "lib/juxta_fram/Kconfig"

# Add more library Kconfig files here as they are created
# source "lib/other_library/Kconfig"

endmenu 
```

## lib/juxta_framfs/Kconfig
```kconfig
config JUXTA_FRAMFS
	bool "JUXTA FRAM File System Library"
	depends on JUXTA_FRAM
	help
	  Enable the JUXTA FRAM file system library. This provides a simple
	  append-only file system on top of the JUXTA FRAM driver.

if JUXTA_FRAMFS

config JUXTA_FRAMFS_LOG_LEVEL
	int "JUXTA FRAMFS Log Level"
	default 3
	range 0 4
	help
	  Sets log level for JUXTA FRAMFS library.
	  0 = OFF, 1 = ERROR, 2 = WARNING, 3 = INFO, 4 = DEBUG

config JUXTA_FRAMFS_FILENAME_LEN
	int "Maximum filename length"
	default 12
	range 8 16
	help
	  Maximum length of filenames including null terminator.
	  Must be a multiple of 4 for alignment.

endif # JUXTA_FRAMFS 
```

## lib/juxta_vitals_nrf52/Kconfig
```kconfig
# Copyright (c) 2024 NeurotechHub
# SPDX-License-Identifier: Apache-2.0

# JUXTA Vitals Library Configuration
#
# Copyright (c) 2024 NeurotechHub
# SPDX-License-Identifier: Apache-2.0

config JUXTA_VITALS_NRF52
	bool "JUXTA Vitals Library for nRF52"
	help
	  Enable the JUXTA Vitals library for nRF52 devices.
	  
	  This library provides:
	  - RTC timestamp management
	  - Battery voltage monitoring
	  - Basic system health monitoring

if JUXTA_VITALS_NRF52

module = JUXTA_VITALS_NRF52
module-str = juxta_vitals_nrf52
source "subsys/logging/Kconfig.template.log_config"

config JUXTA_VITALS_NRF52_BATTERY_UPDATE_INTERVAL
	int "Battery update interval (seconds)"
	default 60
	range 10 3600
	help
	  How often to update battery voltage reading.

config JUXTA_VITALS_NRF52_ENABLE_TEMPERATURE
	bool "Enable temperature monitoring"
	default y
	help
	  Enable internal temperature sensor monitoring.

endif # JUXTA_VITALS_NRF52 
```
